## configs/ci20_defconfig
```kconfig
CONFIG_MIPS=y
CONFIG_ARCH_JZ47XX=y
CONFIG_TARGET_JZ4780_CI20=y
CONFIG_DEFAULT_DEVICE_TREE="ci20"
CONFIG_SPL=y
CONFIG_FIT=y
# CONFIG_CMD_IMLS is not set
CONFIG_CMD_MMC=y
CONFIG_DM_MMC=y
# CONFIG_SPL_DM_MMC is not set
CONFIG_CMD_CACHE
CONFIG_CMD_DHCP=y
CONFIG_CMD_EXT4=y
CONFIG_CMD_FAT=y
CONFIG_JZ4780_EFUSE=y
CONFIG_JZ47XX_GPIO=y
CONFIG_JZ47XX_MMC=y
CONFIG_USE_PRIVATE_LIBGCC=y
CONFIG_SYS_NS16550=y
CONFIG_DM_SERIAL=y
CONFIG_BOOTDELAY=3
```
